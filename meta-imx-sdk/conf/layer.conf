## meta-imx-sdk/conf/layer.conf
```bitbake
# We have a conf and classes directory, add to BBPATH
BBPATH .= ":${LAYERDIR}"

# We have a packages directory, add to BBFILES
BSP_NXP_DERIVED ??= ""
BBFILES += "${@bb.utils.contains_any('MACHINE', '${BSP_NXP_DERIVED}', '${LAYERDIR}/recipes-*/*/*.bb', '', d)}"
BBFILES += "${@bb.utils.contains_any('MACHINE', '${BSP_NXP_DERIVED}', '${LAYERDIR}/recipes-*/*/*.bbappend', '', d)}"

BBFILE_COLLECTIONS += "fsl-sdk-release"
BBFILE_PATTERN_fsl-sdk-release := "^${LAYERDIR}/"
BBFILE_PRIORITY_fsl-sdk-release = "5"

LAYERDEPENDS_fsl-sdk-release = "freescale-distro fsl-bsp-release perl-layer yocto"

LAYERSERIES_COMPAT_fsl-sdk-release = "walnascar whinlatter"

BBMASK += "${LAYERDIR}/recipes-security/"
BBMASK += "${LAYERDIR}/dynamic-layers/(?!multimedia-layer)"
BBMASK += "${LAYERDIR}/recipes-fsl/packagegroup/"
BBMASK += "${LAYERDIR}/recipes-core/packagegroup/"

LAYERSERIES_COMPAT_nxp-matter-baseline:append = " whinlatter"
LAYERSERIES_COMPAT_nxp-web-ui:append = " whinlatter"
LAYERSERIES_COMPAT_nxp-openthread:append = " whinlatter"
LAYERSERIES_COMPAT_imx-demo:append = " whinlatter"
LAYERSERIES_COMPAT_qt6-layer:append = " whinlatter"
LAYERSERIES_COMPAT_meta-freescale-ml:append = " whinlatter"
LAYERSERIES_COMPAT_chromium-browser-layer:append = " whinlatter"
LAYERSERIES_COMPAT_imx-scfw:append = " whinlatter"

# Currently using meta-flutter scarthgap layer
LAYERSERIES_COMPAT_flutter-layer:append = " walnascar whinlatter"
LAYERSERIES_COMPAT_flutter-apps-layer:append = " walnascar whinlatter"
LAYERSERIES_COMPAT_meta-flutter-apps:append = " walnascar whinlatter"
ERROR_QA:remove:layer-flutter-layer = "patch-status"
ERROR_QA:remove:layer-flutter-apps-layer = "buildpaths patch-status"

RECIPE_LIST_REASON:fsl-sdk-release = "You are about to enable third-party components, there is additional third-part licensing involved, and you might need to consult with your legal department."

BBFILES_DYNAMIC += " \
    chromium-browser-layer:${LAYERDIR}/dynamic-layers/chromium-browser-layer/*/*/*.bb \
    chromium-browser-layer:${LAYERDIR}/dynamic-layers/chromium-browser-layer/*/*/*.bbappend \
    clang-layer:${LAYERDIR}/dynamic-layers/clang-layer/*/*/*.bb \
    clang-layer:${LAYERDIR}/dynamic-layers/clang-layer/*/*/*.bbappend \
    flutter-layer:${LAYERDIR}/dynamic-layers/flutter-layer/*/*/*.bb \
    flutter-layer:${LAYERDIR}/dynamic-layers/flutter-layer/*/*/*.bbappend \
    multimedia-layer:${LAYERDIR}/dynamic-layers/multimedia-layer/*/*/*.bb \
    multimedia-layer:${LAYERDIR}/dynamic-layers/multimedia-layer/*/*/*.bbappend \
    nxp-matter-baseline:${LAYERDIR}/dynamic-layers/nxp-matter-baseline/*/*/*.bb \
    nxp-matter-baseline:${LAYERDIR}/dynamic-layers/nxp-matter-baseline/*/*/*.bbappend \
    nxp-openthread:${LAYERDIR}/dynamic-layers/nxp-openthread/*/*/*.bb \
    nxp-openthread:${LAYERDIR}/dynamic-layers/nxp-openthread/*/*/*.bbappend \
    openembedded-layer:${LAYERDIR}/dynamic-layers/openembedded-layer/*/*/*.bb \
    openembedded-layer:${LAYERDIR}/dynamic-layers/openembedded-layer/*/*/*.bbappend \
    qt6-layer:${LAYERDIR}/dynamic-layers/qt6-layer/*/*/*.bb \
    qt6-layer:${LAYERDIR}/dynamic-layers/qt6-layer/*/*/*.bbappend \
    virtualization-layer:${LAYERDIR}/dynamic-layers/virtualization-layer/*/*/*.bb \
    virtualization-layer:${LAYERDIR}/dynamic-layers/virtualization-layer/*/*/*.bbappend \
    networking-layer:${LAYERDIR}/dynamic-layers/networking-layer/*/*/*.bbappend \
"

BBMASK += " \
    meta-freescale-distro/recipes-fsl/packagegroups/packagegroup-fsl-tools-gpu-external.bb \
"
```
